## arch/arm/mach-msm/lge/Kconfig
```kconfig
config MACH_LGE
	bool

menu "LGE Board Selection"
source "arch/arm/mach-msm/lge/Kconfig.board"
endmenu


menu "LGE Specific Patches"

config LGE_HANDLE_PANIC
    tristate "Support LGE Kernel Panic Handler"
    default n
    depends on MACH_LGE
    help
      LGE Error Handler

config LGE_HIDDEN_RESET
	tristate "Support LGE Hidden Reset"
	default n
	depends on MACH_LGE
	help
	  LGE Hidden Reset

config LGE_QFPROM_INTERFACE
    bool "Support qfprom interface"
    default n
    depends on MACH_LGE
    help
    LGE QFPROM DRIVER.

config LGE_SUSPEND_TIME
    tristate "Log time spent in suspend"
    default y
    depends on MACH_LGE
	help
	  Prints the time spent in suspend in the kernel log, and
	  keeps statistics on the time spent in suspend in
	  /sys/kernel/debug/suspend_time

	  This patch serves same function with google's suspend_time.c

config LGE_EARLYSUSPEND_FUNC_TIME
    tristate "Log time spent in each earlysuspend call"
    default y
    depends on MACH_LGE
	help
	  Keeps the time statistics spent in each earlysuspend in
	  /sys/kernel/debug/earlysuspend_func_time.
	  This file shows the average and max tiem of each
	  earlysuspend/lateresume function.

config LGE_QC_LCDC_LUT
     bool "Set initial Qualcomm LCDC lut"
         default n
         depends on MACH_LGE
         help
                Set initail Qualcomm LCDC Look Up Table.
config LGE_KCAL
     bool "Interface to calibrate LCD color temperature"
         default n
         depends on MACH_LGE
         help
                Interface to calibrate LCD color temperature
config LGE_KCAL_QLUT
     bool "Interface to calibrate LCD color temperature by QLUT"
         default n
         depends on MACH_LGE && LGE_QC_LCDC_LUT && LGE_KCAL
         help
                Interface to calibrate LCD color temperature by QLUT

config LGE_LASTLBA_BACKUPGPT
	bool "Force to find Backup GPT at LAST LBA"
	depends on EFI_PARTITION
	help
	  Say Y here if you would like to make kernel always find Backup GPT
	  at Last LBA.

config LGE_BOOT_TIME_CHECK
	tristate "Support LGE BOOT TIME CHECK"
	default y
	depends on MACH_LGE
	help
	LGE SBL1 to LK BOOT TIME CHECKER.

config LGE_ECO_MODE
    tristate "Support LGE ECO Mode"
    default n
    depends on MACH_LGE
    help
      LGE ECO mode support

config LGE_LOG_SERVICE
    tristate "Support LGE Log service"
    default n
    depends on MACH_LGE
    help
      Support LGE Log Service. The author of this patch is cs77.ha@lge.com

endmenu
```

## arch/arm/mach-msm/lge/Kconfig.board
```kconfig
#
# Inlcude the specific Kconfig file for LGE board
#

# J1V
source "arch/arm/mach-msm/lge/j1/Kconfig"
```

## arch/arm/mach-msm/lge/j1/Kconfig
```kconfig
config BOARD_HEADER_FILE
	string "LGE board specific header file name"
	default ""

config MACH_APQ8064_J1V
	depends on ARCH_APQ8064
	select MACH_LGE
		bool "MSM8960 J1V"
	help
	  Support for the LGE Fusion3 J1V device.

config MACH_APQ8064_J1U
	depends on ARCH_APQ8064
	select MACH_LGE
		bool "MSM8960 J1U"
	help
	  Support for the LGE Fusion3 J1U(U+) device.

config MACH_APQ8064_J1A
	depends on ARCH_APQ8064
	select MACH_LGE
		bool "MSM8960 J1A"
	help
	  Support for the LGE Fusion3 J1A(AT&T) device.

config MACH_APQ8064_J1SP
	depends on ARCH_APQ8064
	select MACH_LGE
		bool "MSM8960 J1SP"
	help
	  Support for the LGE Fusion3 J1SP(Sprint) device.

config MACH_APQ8064_J1D
	depends on ARCH_APQ8064
	select MACH_LGE
		bool "MSM8960 J1D"
	help
	  Support for the LGE Fusion3 J1D(Docomo) device.

config MACH_APQ8064_J1SK
	depends on ARCH_APQ8064
	select MACH_LGE
		bool "MSM8960 J1SK"
	help
	  Support for the LGE Fusion3 J1SK(SKT) device.

config MACH_APQ8064_J1KT
	depends on ARCH_APQ8064
	select MACH_LGE
		bool "MSM8960 J1KT"
	help
	  Support for the LGE Fusion3 J1KT(KT) device.

config MACH_APQ8064_J1KD
	depends on ARCH_APQ8064
	select MACH_LGE
		bool "MSM8960 J1KD"
	help
	  Support for the LGE Fusion3 J1D(KDDI) device.
config MACH_APQ8064_J1R
	depends on ARCH_APQ8064
	select MACH_LGE
		bool "MSM8960 J1R"
	help
	  Support for the LGE Fusion3 J1R(ROGERS) device.
config MACH_APQ8064_J1B
	depends on ARCH_APQ8064
	select MACH_LGE
		bool "MSM8960 J1B"
	help
	  Support for the LGE Fusion3 J1B(BELL) device.
config MACH_APQ8064_J1TL
	depends on ARCH_APQ8064
	select MACH_LGE
		bool "MSM8960 J1TL"
	help
	  Support for the LGE Fusion3 J1TL(TELUS) device.
config MACH_APQ8064_J1TM
	depends on ARCH_APQ8064
	select MACH_LGE
		bool "MSM8960 J1TM"
	help
	  Support for the LGE Fusion3 J1TM(TMUS) device.
config MACH_APQ8064_J1VD
	depends on ARCH_APQ8064
	select MACH_LGE
		bool "MSM8960 J1VD"
	help
	  Support for the LGE Fusion3 J1VD(VDF) device.
config MACH_APQ8064_J1X
	depends on ARCH_APQ8064
	select MACH_LGE
		bool "MSM8960 J1X"
	help
	  Support for the LGE Fusion3 J1X(VDF) device.

config MACH_APQ8064_GKU
	depends on ARCH_APQ8064
	select MACH_LGE
		bool "MSM8960 GKU"
	help
	  Support for the LGE Fusion3 GKU(U+) device.

config MACH_APQ8064_GKSK
	depends on ARCH_APQ8064
	select MACH_LGE
		bool "MSM8960 GKSK"
	help
	  Support for the LGE Fusion3 GKSK(SKT) device.

config MACH_APQ8064_GKKT
	depends on ARCH_APQ8064
	select MACH_LGE
		bool "MSM8960 GKKT"
	help
	  Support for the LGE Fusion3 GKKT(KT) device.

config LGE_USB_DIAG_DISABLE
	default n
	bool "Disable diag function"
	help
	 Provide method of diag enable or disable
```

## drivers/broadcast/oneseg/Kconfig
```kconfig
#menu "BROADCAST_DEVICE"

#
# Broadcast Device Driver Support
#

#menu "BROADCAST_DEVICE"

config LGE_BROADCAST_ONESEG_MB86A35S
	bool "1Seg broacast tuner chipset mb86a35s  device driver"
	depends on LGE_BROADCAST_ONESEG && MACH_APQ8064_J1D
	default y
	help
	  Select this if you want to use Japanese 1Seg mobile broadcast service
	  
config LGE_BROADCAST_ONESEG_FC8150
	bool "1Seg broacast tuner chipset fc8150  device driver"
	depends on LGE_BROADCAST_ONESEG && MACH_APQ8064_J1KD
	default y
	help
	  Select this if you want to use Japanese 1Seg mobile broadcast service
	  
#endmenu
```
